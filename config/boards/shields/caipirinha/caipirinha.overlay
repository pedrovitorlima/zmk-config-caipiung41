#include <dt-bindings/zmk/matrix_transform.h>

/ {
    chosen {
        zmk,kscan = &default_kscan;
        zmk,matrix_transform = &default_transform;
    };

    default_kscan: kscan {
        compatible = "zmk,kscan-gpio-matrix";
        label = "default_kscan";
        diode-direction = "row2column";

        col-gpios = <&pro_micro 19 (GPIO_ACTIVE_HIGH | GPIO_PULL_DOWN)>;  /* Col6 */

        row-gpios = <&pro_micro 9  GPIO_ACTIVE_HIGH>;  /* Row4 */
    };

    default_transform: matrix-transform {
        compatible = "zmk,matrix-transform";
        rows = <1>;
        columns = <1>;

        map = <RC(0,0)>;
    };


};
