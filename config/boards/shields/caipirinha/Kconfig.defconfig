## config/boards/shields/reviung-hard/Kconfig.defconfig
```kconfig
if SHIELD_REVIUNG-HARD

config ZMK_KEYBOARD_NAME
    default "reviung-hard"

endif
```

## config/boards/shields/reviunghand/Kconfig.defconfig
```kconfig
if SHIELD_REVIUNGHAND

config ZMK_KEYBOARD_NAME
    default "reviunghand"

endif
```

## config/west.yml
```yaml
manifest:
  remotes:
    - name: zmkfirmware
      url-base: https://github.com/zmkfirmware
  projects:
    - name: zmk
      remote: zmkfirmware
      revision: main
      import: app/west.yml
    - name: caipirinha
      path: modules/caipirinha
      revision: main
  self:
    path: config
```
