/*
 * Copyright (c) 2020 The ZMK Contributors
 *
 * SPDX-License-Identifier: MIT
 */

#include <behaviors.dtsi>
#include <dt-bindings/zmk/keys.h>

/ {
    behaviors {
        hm: homerow_mods {
            compatible = "zmk,behavior-hold-tap";
            label = "HOMEROW_MODS";
            bindings = <&kp>, <&kp>;

            #binding-cells = <2>;
            tapping-term-ms = <200>;
            flavor = "tap-preferred";
            require-prior-idle-ms = <125>;
            quick-tap-ms = <200>;
        };

        shifthr: shifthr {
            compatible = "zmk,behavior-hold-tap";
            label = "SHIFTHR";
            bindings = <&kp>, <&kp>;

            #binding-cells = <2>;
            tapping-term-ms = <185>;
            flavor = "tap-preferred";
            quick-tap-ms = <185>;
        };

        weak: weak {
            compatible = "zmk,behavior-hold-tap";
            label = "WEAK";
            bindings = <&kp>, <&kp>;

            #binding-cells = <2>;
            tapping-term-ms = <230>;
            flavor = "tap-preferred";
            require-prior-idle-ms = <125>;
            quick-tap-ms = <230>;
        };
    };

    keymap {
        compatible = "zmk,keymap";

        bindings = <
          &kp TAB  &kp Q  &kp W     &kp E        &kp R  &kp T             &kp Y        &kp U     &kp I      &kp O     &kp P   &kp BSPC
        &kp LCTRL  &kp A  &kp S     &kp D        &kp F  &kp G             &kp H        &kp J     &kp K      &kp L  &kp SEMI    &kp SQT
        &kp LSHFT  &kp Z  &kp X     &kp C        &kp V  &kp B             &kp B        &kp N     &kp M  &kp COMMA   &kp DOT  &kp SLASH
                                 &kp LGUI  &lt 1 SPACE         &kp ENTER         &lt 2 SPACE  &kp RALT
                    >;

        };

    };
};
